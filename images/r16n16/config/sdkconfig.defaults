## images/r16n16/config/sdkconfig.defaults
```kconfig
# r16n16 Configuration
# 16MB PSRAM + 16MB SPI Flash

# ESP-IDF Target
CONFIG_IDF_TARGET="esp32s3"

# Flash Configuration
CONFIG_ESPTOOLPY_FLASHSIZE_16MB=y
CONFIG_ESPTOOLPY_FLASHMODE_QIO=y
CONFIG_ESPTOOLPY_FLASHFREQ_80M=y

# PSRAM Configuration
CONFIG_SPIRAM=y
CONFIG_SPIRAM_MODE_OCT=y
CONFIG_SPIRAM_SPEED_80M=y
CONFIG_SPIRAM_SIZE=16777216

# Partition Table
CONFIG_PARTITION_TABLE_CUSTOM=y
CONFIG_PARTITION_TABLE_CUSTOM_FILENAME="partitions.csv"

# Application
CONFIG_BOOTLOADER_APP_ROLLBACK_ENABLE=y
CONFIG_BOOTLOADER_APP_ANTI_ROLLBACK=y

# Networking
CONFIG_ESP_WIFI_STATIC_RX_BUFFER_NUM=10
CONFIG_ESP_WIFI_DYNAMIC_RX_BUFFER_NUM=32
CONFIG_ESP_WIFI_DYNAMIC_TX_BUFFER_NUM=16

# Memory
CONFIG_SYSTEM_EVENT_TASK_STACK_SIZE=4096
CONFIG_ESP_SYSTEM_EVENT_TASK_STACK_SIZE=4096

# Logging
CONFIG_LOG_DEFAULT_LEVEL_INFO=y
CONFIG_LOG_DEFAULT_LEVEL=3

# OTA
CONFIG_BOOTLOADER_APP_ROLLBACK_ENABLE=y

# Extended Storage
CONFIG_STORAGE_PARTITION_SIZE=0x200000

# Extended Stack
CONFIG_ESP_MAIN_TASK_STACK_SIZE=8192
CONFIG_ESP_SYSTEM_EVENT_TASK_STACK_SIZE=4096
```

## images/r8n8/config/sdkconfig.defaults
```kconfig
# r8n8 Configuration - 8MB PSRAM + 8MB SPI Flash

CONFIG_IDF_TARGET="esp32s3"

# Flash
CONFIG_ESPTOOLPY_FLASHSIZE_8MB=y
CONFIG_ESPTOOLPY_FLASHMODE_QIO=y
CONFIG_ESPTOOLPY_FLASHFREQ_80M=y

# PSRAM
CONFIG_SPIRAM=y
CONFIG_SPIRAM_MODE_OCT=y
CONFIG_SPIRAM_SPEED_80M=y

# Partition Table
CONFIG_PARTITION_TABLE_CUSTOM=y
CONFIG_PARTITION_TABLE_CUSTOM_FILENAME="partitions.csv"

# OTA
CONFIG_BOOTLOADER_APP_ROLLBACK_ENABLE=y

# Logging
CONFIG_LOG_DEFAULT_LEVEL_INFO=y
CONFIG_LOG_DEFAULT_LEVEL=3

# Stack
CONFIG_ESP_MAIN_TASK_STACK_SIZE=4096
CONFIG_ESP_SYSTEM_EVENT_TASK_STACK_SIZE=2048
```

## mculinux-packages/packages/linux-esp32s3/configs/esp32s3_defconfig
```kconfig
# MCUlinux ESP32-S3 Kernel Config Fragment
# This is applied on top of xtensa-esp32s3_defconfig

# Xtensa architecture
CONFIG_XTENSA_VARIANT_CUSTOM=y
CONFIG_XTENSA_VARIANT_CUSTOM_NAME="esp32s3"
CONFIG_XTENSA_PLATFORM_ESP32=y
CONFIG_XIP_KERNEL=y
CONFIG_KERNEL_LOAD_ADDRESS=0x42120000
CONFIG_XIP_DATA_ADDR=0x3d800000
CONFIG_DEFAULT_MEM_START=0x3d800000
CONFIG_MEMMAP_CACHEATTR=0xffff222f
CONFIG_BUILTIN_DTB_NAME="esp32s3-devkit-c1"

# Optimizations
CONFIG_CC_OPTIMIZE_FOR_SIZE=y
CONFIG_LD_DEAD_CODE_DATA_ELIMINATION=y

# Memory
CONFIG_MTD=y
CONFIG_MTD_BLOCK=y
CONFIG_MTD_ESP32=y
CONFIG_MTD_PHYSMAP=y
CONFIG_MTD_PHYSMAP_OF=y

# Serial
CONFIG_SERIAL_ESP32=y
CONFIG_SERIAL_ESP32_ACM=y

# GPIO
CONFIG_GPIOLIB=y
CONFIG_GPIO_SYSFS=y
CONFIG_GPIO_ESP32=y

# SPI
CONFIG_SPI=y
CONFIG_SPI_ESP32=y

# Hardware
CONFIG_HW_RANDOM_ESP32=y
CONFIG_I2C=y
CONFIG_I2C_GPIO=y

# Clock
CONFIG_COMMON_CLK_ESP32S3=y
CONFIG_RESET_CONTROLLER=y
CONFIG_RESET_SIMPLE=y

# Network
CONFIG_NET=y
CONFIG_INET=y
CONFIG_NETDEVICES=y
CONFIG_ESP32_WIFI=y
CONFIG_CFG80211=y
CONFIG_RFKILL=y

# Filesystem
CONFIG_EROFS_FS=y
CONFIG_EROFS_FS_ZIP=y
CONFIG_EROFS_FS_ZIP_LZMA=y
CONFIG_JFFS2_FS=y
CONFIG_DEVTMPFS=y
CONFIG_DEVTMPFS_MOUNT=y

# Init
CONFIG_INITRAMFS_SOURCE=""
CONFIG_BLK_DEV_INITRD=y

# Debugging
CONFIG_PRINTK_TIME=y
CONFIG_MAGIC_SYSRQ=y
CONFIG_DEBUG_FS=y
```
